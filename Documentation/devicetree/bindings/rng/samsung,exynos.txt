## Documentation/devicetree/bindings/rng/samsung,exynos.txt
```
Exynos Random number generator

Required properties:

- compatible : should be "samsung,exynos-rng"
- reg : Specifies base physical address and size of the registers.

Example:

rng {
        compatible = "samsung,exynos-rng";
        reg = <0x7e104000 0x10>;
};
```

## Documentation/devicetree/bindings/video/exynos_hdmi.txt
```
Device-Tree bindings for drm hdmi driver

Required properties:
- compatible: value should be one among the following:
	1) "samsung,exynos5-hdmi" <DEPRECATED>
	2) "samsung,exynos4210-hdmi"
	3) "samsung,exynos4212-hdmi"
- reg: physical base address of the hdmi and length of memory mapped
	region.
- interrupts: interrupt number to the cpu.
- hpd-gpio: following information about the hotplug gpio pin.
	a) phandle of the gpio controller node.
	b) pin number within the gpio controller.
	c) optional flags and pull up/down.
- clocks: list of clock IDs from SoC clock driver.
	a) hdmi: Gate of HDMI IP bus clock.
	b) sclk_hdmi: Gate of HDMI special clock.
	c) sclk_pixel: Pixel special clock, one of the two possible inputs of
		HDMI clock mux.
	d) sclk_hdmiphy: HDMI PHY clock output, one of two possible inputs of
		HDMI clock mux.
	e) mout_hdmi: It is required by the driver to switch between the 2
		parents i.e. sclk_pixel and sclk_hdmiphy. If hdmiphy is stable
		after configuration, parent is set to sclk_hdmiphy else
		sclk_pixel.
- clock-names: aliases as per driver requirements for above clock IDs:
	"hdmi", "sclk_hdmi", "sclk_pixel", "sclk_hdmiphy" and "mout_hdmi".
- hdmiphy-confs: following information about the hdmiphy conf settings.
        a) "nr-confs" specifies the number of pixel clocks supported.
	b) "confX: confX" specifies the phy configuration settings,
		"clock-frequency" specifies the pixel clock
		"conf" specifies the setting for the corresponding pixel clock
Example:

	hdmi {
		compatible = "samsung,exynos4212-hdmi";
		reg = <0x14530000 0x100000>;
		interrupts = <0 95 0>;
		hpd-gpio = <&gpx3 7 1>;
		hdmiphy-confs {
			nr-confs = <1>;
			conf0: conf0 {
				clock-frequency = <25200000>;
				conf =  /bits/ 8 <
					0x01 0x51 0x2A 0x75 0x40 0x01 0x00 0x08
					0x82 0x80 0xfc 0xd8 0x45 0xa0 0xac 0x80
					0x08 0x80 0x11 0x04 0x02 0x22 0x44 0x86
					0x54 0xf4 0x24 0x00 0x00 0x00 0x01 0x80
				>;
			};
		}
	};
```

## drivers/gpu/drm/mali/Kconfig
```kconfig
config DRM_MALI
	tristate "Mali DRM supprt"
	help
	  Choose this option if you have a Mali 200 or Mali 400 gpu
	  If M is selected the module will be called mali_drm.
```
